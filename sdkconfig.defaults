## sdkconfig.defaults
```kconfig
# =============================================================================
# Stack Size Configurations
# =============================================================================

# Rust needs a larger main task stack size compared to C.
# Bumped from 8192 to 20480 to prevent stack overflows during recursive directory trees.
CONFIG_ESP_MAIN_TASK_STACK_SIZE=32768

# Increase system event task stack size (default is often too small for Rust)
CONFIG_ESP_SYSTEM_EVENT_TASK_STACK_SIZE=8192

# Increase idle task stack size 
CONFIG_FREERTOS_IDLE_TASK_STACKSIZE=4096

# Increase default pthread stack size (used when spawning std::thread units)
CONFIG_PTHREAD_TASK_STACK_SIZE_DEFAULT=8192

# =============================================================================
# Panic & Exception Behavior (Halt on Crash)
# =============================================================================

# Configure the ESP-IDF panic handler to print registers/backtraces and halt
CONFIG_ESP_SYSTEM_PANIC_PRINT_HALT=y

# Explicitly disable the automatic reboot loop on hardware panics
CONFIG_ESP_SYSTEM_PANIC_PRINT_REBOOT=n
```
